// SPDX-License-Identifier: BSD-3-Clause
/*
 * Copyright (c) 2023-2024 Qualcomm Innovation Center, Inc. All rights reserved.
 */

/dts-v1/;
/plugin/;

#include "../parrot-audio-qrd.dtsi"
#include "../parrot-sec-a36xq-audio-pinctrl-common.dtsi"
#include "../parrot-sec-a36xq-audio-common.dtsi"

/ {
	model = "Samsung A36XQ PROJECT (board-id,11)";
	compatible = "qcom,parrot-qrd", "qcom,parrot", "qcom,qrd";
	qcom,msm-id = <537 0x10000>, <583 0x10000>, <613 0x10000>, <631 0x10000>,
			<633 0x10000>, <634 0x10000>, <638 0x10000>,
			<663 0x10000>;
	qcom,board-id = <0x1000B 11>;
};
