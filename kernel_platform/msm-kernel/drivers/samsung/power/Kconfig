## kernel_platform/msm-kernel/drivers/samsung/power/Kconfig
```kconfig
config SEC_PM
	bool "Samsung PowerManagement Feature"
	default y
	help
	  Samsung PowerManagement Feature.
```

## kernel_platform/msm-kernel/drivers/sensors/Kconfig
```kconfig
# SPDX-License-Identifier: GPL-2.0-only

config SENSORS
	tristate "Sensors Class Support"
	help
	  This option enables the sensor sysfs class in /sys/class/sensors.
	  You'll need this to do anything useful with sensors. If unsure, say N.

#
# grip sensors configuration
#
config SENSORS_A96T396
	depends on I2C
	tristate "A96T396 driver for grip"
	default n
	help
	  If you say yes here if you use A96T396 for grip.
	  This option enables grip sensors using
	  Above A96T396 device driver for grip.

config SENSORS_A96T396_SUB
	depends on I2C
	tristate "A96T396_SUB driver for grip"
	default n
	help
	  Say Y here if you use A96T396_SUB for grip.
	  This option enables grip sensors using
	  Above A96T396_SUB device driver for grip.

config SENSORS_A96T396_SUB2
	depends on I2C
	tristate "A96T396_SUB2 driver for grip"
	default n
	help
	  Say Y here if you use A96T396_SUB2 for grip.
	  This option enables grip sensors using
	  Above A96T396_SUB2 device driver for grip.

config SENSORS_A96T396_WIFI
	depends on I2C
	tristate "A96T396_WIFI driver for grip"
	default n
	help
	  Say Y here if you use A96T396_WIFI for grip.
	  This option enables grip sensors using
	  Above A96T396_WIFI device driver for grip.

config SENSORS_CORE_AP
	tristate "Need to use Sensors core ap version"
	default n
	help
	  Say Y here if you using sensors_core.c included under drivers/sensors etc.

config SENSORS_A96T396_CH1
	depends on I2C
	tristate "SENSORS_A96T396_CH1 driver for grip 1ch"
	default n
	help
	  Say Y here if you use model grip 1ch.

config SENSORS_A96T396_CH2
	depends on I2C
	tristate "SENSORS_A96T396_CH2 driver for grip 2ch"
	default n
	help
	  Say Y here if you use model grip 2ch.

config SENSORS_GRIP_FAILURE_DEBUG
	bool "Grip failure debug"
	help
	  Say Y here, Enable Grip failure debug flag.
```

## vendor/qcom/opensource/display-drivers/sec_display_defconfig
```kconfig
CONFIG_PANEL_A36_ANA6710_AMS663FS02_FHD=y
CONFIG_PANEL_A36_S6E3FC5_AMS663FS01_FHD=y
CONFIG_DISPLAY_SAMSUNG=y
CONFIG_LCD_CLASS_DEVICE=y
```

## vendor/qcom/opensource/wlan/platform/icnss2/volcano_consolidate_defconfig
```kconfig
CONFIG_ICNSS2=m
CONFIG_ICNSS2_QMI=y
CONFIG_CNSS_QMI_SVC=m
CONFIG_CNSS_OUT_OF_TREE=y
CONFIG_WCNSS_MEM_PRE_ALLOC=m
CONFIG_ICNSS2_DEBUG=y
CONFIG_SEC_SS_CNSS_FEATURE_SYSFS=y
```
