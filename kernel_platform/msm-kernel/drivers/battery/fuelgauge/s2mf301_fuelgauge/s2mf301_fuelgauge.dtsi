/*
 * s2mf301 battery device tree common
 *
 * Copyright (c) 2022 Samsung Electronics Co., Ltd.
 *		http://www.samsung.com
 *
 * This program is free software; you can redistribute it and/or modify
 * it under the terms of the GNU General Public License version 2 as
 * published by the Free Software Foundation.
 */

&smd {
	s2mf301_fuelgauge: s2mf301-fuelgauge {
		status = "okay";
		fuelgauge,capacity_full = <5000>;
		fuelgauge,low_voltage_limit_lowtemp = <3100>;
		fuelgauge,fuel_alert_soc = <1>;
		fuelgauge,capacity_max = <1000>;
		fuelgauge,capacity_max_margin = <200>;
		fuelgauge,capacity_min = <0>;
		fuelgauge,capacity_calculation_type = <28>;
		fuelgauge,use_external_temp;
#if 0
		fuelgauge,bat_id_gpio = <
				SEC_GPIO_REF(${bat_id_single_gpio}) 0  /* BAT_ID_1 */
				>;
#elif 1
		fuelgauge,bat_id_gpio = <
				SEC_GPIO_REF(PM,pm6150l_gpios,12) 0  /* BAT_ID_2 */
				SEC_GPIO_REF(PM,pm6150l_gpios,11) 0  /* BAT_ID_1 */
				>;
#endif
	};
};

&smd {
	battery {
		battery,fgsrc_switch_name = "s2mf301-fuelgauge"; /* Fuelgauge voltage source */
	};
};


/* /home/dpi/qb5_8814/workspace/P4_1716/android/kernel_platform/kmodule/battery/suwon/fuelgauge/s2mf301/a36xq/s2mf301_fuelgauge.dtsi */
/*
 * s2mf301 battery device tree common
 *
 * Copyright (c) 2023 Samsung Electronics Co., Ltd.
 *		http://www.samsung.com
 *
 * This program is free software; you can redistribute it and/or modify
 * it under the terms of the GNU General Public License version 2 as
 * published by the Free Software Foundation.
 */

&smd {
	s2mf301_fuelgauge: s2mf301-fuelgauge {
		status = "okay";
		fuelgauge,capacity_full = <5000>;
		fuelgauge,low_voltage_limit_lowtemp = <3100>;
		fuelgauge,low_voltage_limit = <3350>;
		fuelgauge,fuel_alert_soc = <1>;
		fuelgauge,capacity_max = <1000>;
		fuelgauge,capacity_max_margin = <200>;
		fuelgauge,capacity_min = <0>;
		fuelgauge,capacity_calculation_type = <28>;
		fuelgauge,use_external_temp;
		/* zadj data [0x12] [0x13] [0x15] */
		fuelgauge3,zadj_data = <
			/* zadj data for 4.48 */
			2 0 1
			/* zadj data for 4.46 */
			2 0 1
			/* zadj data for 4.44 */
			2 0 1
			/* zadj data for 4.42 */
			2 0 1
			/* zadj data for 4.37 */
			2 0 1
			>;
		fuelgauge2,zadj_data = <
			/* zadj data for 4.48 */
			2 0 1
			/* zadj data for 4.46 */
			2 0 1
			/* zadj data for 4.44 */
			2 0 1
			/* zadj data for 4.42 */
			2 0 1
			/* zadj data for 4.37 */
			2 0 1
			>;
		fuelgauge1,zadj_data = <
			/* zadj data for 4.48 */
			0 2 0
			/* zadj data for 4.46 */
			0 2 0
			/* zadj data for 4.44 */
			0 2 0
			/* zadj data for 4.42 */
			0 2 0
			/* zadj data for 4.37 */
			0 2 0
			>;
		fuelgauge0,zadj_data = <
			/* zadj data for 4.48 */
			2 0 1
			/* zadj data for 4.46 */
			2 0 1
			/* zadj data for 4.44 */
			2 0 1
			/* zadj data for 4.42 */
			2 0 1
			/* zadj data for 4.37 */
			2 0 1
			>;
#if 1
		fuelgauge,bat_id_gpio = <
				SEC_GPIO_REF(PM,pm6150l_gpios,12) 0  /* BAT_ID_2 */
				SEC_GPIO_REF(PM,pm6150l_gpios,11) 0  /* BAT_ID_1 */
				>;
		fuelgauge,bat_id_cutoff_level = <3300 3400 3300 3300>;
#endif
	};
};

&smd {
	battery {
		battery,fgsrc_switch_name = "s2mf301-fuelgauge"; /* Fuelgauge voltage source */
	};
};

&smd {
	s2mf301_battery_params: battery_params {
	/*
	 * BAT_ID_1/BAT_ID_2
	 * 01: ATL/SDI Safety, 00: ATL
	 * 10: SDI, 11: ATL
	 */

	/* 11: ATL_safe */
		battery3,battery_data = <
			/***** battery data for 4.48 *****/
			/* battery,battery_table3 */
			151 11 40 11 191 10 73 10 203 9
			79 9 216 8 107 8 8 8 151 7
			35 7 226 6 173 6 131 6 96 6
			59 6 7 6 207 5 142 5 116 5
			172 2 231 0 0 8 154 7 52 7
			206 6 104 6 2 6 156 5 54 5
			208 4 106 4 4 4 158 3 56 3
			210 2 108 2 6 2 160 1 57 1
			212 0 110 0 7 0 245 15

			/* battery,battery_table4 */
			13 13 13 13 26 26 25 25 25 26
			26 26 26 26 27 27 27 27 27 27
			28 154

			/* battery,batcap */
			0xf8 0x51 0xb8 0xb /* [0x0E] [0x0F] [0x10] [0x11] */

			/* battery,designcap */
			0xf8 0x51 /* [0x86~0x87] */

			/* battery,batcap_ocv_new */
			0xf9 0x51 /* 0x90~0x91 */

			/* battery,soc_arr_val */
			10000 9502 9003 8505 8007 7509 7011 6513 6014 5516
			5018 4520  4022 3523 3025 2527 2029 1531 1033 535
			37 (-53)

			/* battery,ocv_arr_val */
			44486 43943 43431 42857 42242 41634 41056 40521 40038 39486
			38922 38602 38346 38140 37970 37786 37532 37259 36945 36817
			33341 31126

			/* battery,rRS_CC0 */
			0x13 /* [0x5C] */

			/***** battery data for 4.46 *****/
			/* battery,battery_table3 */
			151 11 40 11 191 10 73 10 203 9
			79 9 216 8 107 8 8 8 151 7
			35 7 226 6 173 6 131 6 96 6
			59 6 7 6 207 5 142 5 116 5
			172 2 231 0 31 8 183 7 80 7
			232 6 129 6 25 6 178 5 74 5
			226 4 123 4 19 4 172 3 68 3
			221 2 117 2 13 2 166 1 62 1
			215 0 111 0 8 0 245 15

			/* battery,battery_table4 */
			13 13 13 13 26 26 25 25 25 26
			26 26 26 26 27 27 27 27 27 27
			28 154

			/* battery,batcap */
			0x30 0x4d 0x82 0xd /* [0x0E] [0x0F] [0x10] [0x11] */

			/* battery,designcap */
			0x30 0x4d /* [0x86~0x87] */

			/* battery,batcap_ocv_new */
			0x31 0x4d /* 0x90~0x91 */

			/* battery,soc_arr_val */
			10152 9646 9140 8634 8129 7623 7117 6611 6105 5600
			5094 4588 4083 3577 3071 2566 2060 1554 1048 543
			37 (-53)

			/* battery,ocv_arr_val */
			44486 43943 43431 42857 42242 41634 41056 40521 40038 39486
			38922 38602 38346 38140 37970 37786 37532 37259 36945 36817
			33341 31126

			/* battery,rRS_CC0 */
			0x13 /* [0x5C] */

			/***** battery data for 4.44 *****/
			/* battery,battery_table3 */
			151 11 40 11 191 10 73 10 203 9
			79 9 216 8 107 8 8 8 151 7
			35 7 226 6 173 6 131 6 96 6
			59 6 7 6 207 5 142 5 116 5
			172 2 231 0 72 8 222 7 116 7
			11 7 161 6 56 6 206 5 101 5
			251 4 145 4 40 4 190 3 85 3
			235 2 129 2 24 2 174 1 68 1
			219 0 113 0 8 0 245 15

			/* battery,battery_table4 */
			13 13 13 13 26 26 25 25 25 26
			26 26 26 26 27 27 27 27 27 27
			28 154

			/* battery,batcap */
			0xb4 0x4b 0x3f 0xd /* [0x0E] [0x0F] [0x10] [0x11] */

			/* battery,designcap */
			0xb4 0x4b /* [0x86~0x87] */

			/* battery,batcap_ocv_new */
			0xb5 0x4b /* 0x90~0x91 */

			/* battery,soc_arr_val */
			10350 9835 9319 8803 8288 7772 7257 6741 6225 5710
			5194 4678 4163 3647 3131 2616 2100 1584 1069 554
			38 (-54)

			/* battery,ocv_arr_val */
			44486 43943 43431 42857 42242 41634 41056 40521 40038 39486
			38922 38602 38346 38140 37970 37786 37532 37259 36945 36817
			33341 31126

			/* battery,rRS_CC0 */
			0x13 /* [0x5C] */

			/***** battery data for 4.42 *****/
			/* battery,battery_table3 */
			151 11 40 11 191 10 73 10 203 9
			79 9 216 8 107 8 8 8 151 7
			35 7 226 6 173 6 131 6 96 6
			59 6 7 6 207 5 142 5 116 5
			172 2 231 0 114 8 6 8 155 7
			47 7 195 6 88 6 236 5 128 5
			20 5 169 4 61 4 209 3 102 3
			250 2 142 2 34 2 183 1 75 1
			223 0 116 0 8 0 245 15

			/* battery,battery_table4 */
			13 13 13 13 26 26 25 25 25 26
			26 26 26 26 27 27 27 27 27 27
			28 154

			/* battery,batcap */
			0x3c 0x4a 0xfd 0xc  /* [0x0E] [0x0F] [0x10] [0x11] */

			/* battery,designcap */
			0x3c 0x4a /* [0x86~0x87] */

			/* battery,batcap_ocv_new */
			0x3d 0x4a /* 0x90~0x91 */

			/* battery,soc_arr_val */
			10557 10031 9505 8979 8454 7927 7402 6876 6349 5824
			5298 4771 4246 3720 3194 2668 2142 1616 1090 565
			39 (-55)

			/* battery,ocv_arr_val */
			44486 43943 43431 42857 42242 41634 41056 40521 40038 39486
			38922 38602 38346 38140 37970 37786 37532 37259 36945 36817
			33341 31126

			/* battery,rRS_CC0 */
			0x13 /* [0x5C] */

			/***** battery data for 4.37 *****/
			/* battery,battery_table3 */
			151 11 40 11 191 10 73 10 203 9
			79 9 216 8 107 8 8 8 151 7
			35 7 226 6 173 6 131 6 96 6
			59 6 7 6 207 5 142 5 116 5
			172 2 231 0 227 8 113 8 0 8
			143 7 29 7 172 6 59 6 201 5
			88 5 231 4 117 4 4 4 147 3
			33 3 176 2 63 2 206 1 92 1
			235 0 122 0 8 0 244 15

			/* battery,battery_table4 */
			13 13 13 13 13 26 25 25 25 26
			26 26 26 26 27 27 27 27 27 27
			28 154

			/* battery,batcap */
			0x90 0x46 0x59 0xc /* [0x0E] [0x0F] [0x10] [0x11] */

			/* battery,designcap */
			0x90 0x46 /* [0x86~0x87] */

			/* battery,batcap_ocv_new */
			0x91 0x46 /* 0x90~0x91 */

			/* battery,soc_arr_val */
			11106 10553 9999 9446 8893 8340 7787 7233 6679 6127
			5573 5019 4466 3913 3360 2807 2254 1700 1147 594
			41 (-58)

			/* battery,ocv_arr_val */
			44486 43943 43431 42857 42242 41634 41056 40521 40038 39486
			38922 38602 38346 38140 37970 37786 37532 37259 36945 36817
			33341 31126

			/* battery,rRS_CC0 */
			0x13 /* [0x5C] */

			>;
	/* 10: SDI */
		battery2,battery_data = <
			/***** battery data for 4.48 *****/
			/* battery,battery_table3 */
			151 11 40 11 191 10 73 10 203 9
			79 9 216 8 107 8 8 8 151 7
			35 7 226 6 173 6 131 6 96 6
			59 6 7 6 207 5 142 5 116 5
			172 2 231 0 0 8 154 7 52 7
			206 6 104 6 2 6 156 5 54 5
			208 4 106 4 4 4 158 3 56 3
			210 2 108 2 6 2 160 1 57 1
			212 0 110 0 7 0 245 15

			/* battery,battery_table4 */
			13 13 13 13 26 26 25 25 25 26
			26 26 26 26 27 27 27 27 27 27
			28 154

			/* battery,batcap */
			0xf8 0x51 0xb8 0xb /* [0x0E] [0x0F] [0x10] [0x11] */

			/* battery,designcap */
			0xf8 0x51 /* [0x86~0x87] */

			/* battery,batcap_ocv_new */
			0xf9 0x51 /* 0x90~0x91 */

			/* battery,soc_arr_val */
			10000 9502 9003 8505 8007 7509 7011 6513 6014 5516
			5018 4520  4022 3523 3025 2527 2029 1531 1033 535
			37 (-53)

			/* battery,ocv_arr_val */
			44486 43943 43431 42857 42242 41634 41056 40521 40038 39486
			38922 38602 38346 38140 37970 37786 37532 37259 36945 36817
			33341 31126

			/* battery,rRS_CC0 */
			0x13 /* [0x5C] */

			/***** battery data for 4.46 *****/
			/* battery,battery_table3 */
			151 11 40 11 191 10 73 10 203 9
			79 9 216 8 107 8 8 8 151 7
			35 7 226 6 173 6 131 6 96 6
			59 6 7 6 207 5 142 5 116 5
			172 2 231 0 31 8 183 7 80 7
			232 6 129 6 25 6 178 5 74 5
			226 4 123 4 19 4 172 3 68 3
			221 2 117 2 13 2 166 1 62 1
			215 0 111 0 8 0 245 15

			/* battery,battery_table4 */
			13 13 13 13 26 26 25 25 25 26
			26 26 26 26 27 27 27 27 27 27
			28 154

			/* battery,batcap */
			0x30 0x4d 0x82 0xd /* [0x0E] [0x0F] [0x10] [0x11] */

			/* battery,designcap */
			0x30 0x4d /* [0x86~0x87] */

			/* battery,batcap_ocv_new */
			0x31 0x4d /* 0x90~0x91 */

			/* battery,soc_arr_val */
			10152 9646 9140 8634 8129 7623 7117 6611 6105 5600
			5094 4588 4083 3577 3071 2566 2060 1554 1048 543
			37 (-53)

			/* battery,ocv_arr_val */
			44486 43943 43431 42857 42242 41634 41056 40521 40038 39486
			38922 38602 38346 38140 37970 37786 37532 37259 36945 36817
			33341 31126

			/* battery,rRS_CC0 */
			0x13 /* [0x5C] */

			/***** battery data for 4.44 *****/
			/* battery,battery_table3 */
			151 11 40 11 191 10 73 10 203 9
			79 9 216 8 107 8 8 8 151 7
			35 7 226 6 173 6 131 6 96 6
			59 6 7 6 207 5 142 5 116 5
			172 2 231 0 72 8 222 7 116 7
			11 7 161 6 56 6 206 5 101 5
			251 4 145 4 40 4 190 3 85 3
			235 2 129 2 24 2 174 1 68 1
			219 0 113 0 8 0 245 15

			/* battery,battery_table4 */
			13 13 13 13 26 26 25 25 25 26
			26 26 26 26 27 27 27 27 27 27
			28 154

			/* battery,batcap */
			0xb4 0x4b 0x3f 0xd /* [0x0E] [0x0F] [0x10] [0x11] */

			/* battery,designcap */
			0xb4 0x4b /* [0x86~0x87] */

			/* battery,batcap_ocv_new */
			0xb5 0x4b /* 0x90~0x91 */

			/* battery,soc_arr_val */
			10350 9835 9319 8803 8288 7772 7257 6741 6225 5710
			5194 4678 4163 3647 3131 2616 2100 1584 1069 554
			38 (-54)

			/* battery,ocv_arr_val */
			44486 43943 43431 42857 42242 41634 41056 40521 40038 39486
			38922 38602 38346 38140 37970 37786 37532 37259 36945 36817
			33341 31126

			/* battery,rRS_CC0 */
			0x13 /* [0x5C] */

			/***** battery data for 4.42 *****/
			/* battery,battery_table3 */
			151 11 40 11 191 10 73 10 203 9
			79 9 216 8 107 8 8 8 151 7
			35 7 226 6 173 6 131 6 96 6
			59 6 7 6 207 5 142 5 116 5
			172 2 231 0 114 8 6 8 155 7
			47 7 195 6 88 6 236 5 128 5
			20 5 169 4 61 4 209 3 102 3
			250 2 142 2 34 2 183 1 75 1
			223 0 116 0 8 0 245 15

			/* battery,battery_table4 */
			13 13 13 13 26 26 25 25 25 26
			26 26 26 26 27 27 27 27 27 27
			28 154

			/* battery,batcap */
			0x3c 0x4a 0xfd 0xc  /* [0x0E] [0x0F] [0x10] [0x11] */

			/* battery,designcap */
			0x3c 0x4a /* [0x86~0x87] */

			/* battery,batcap_ocv_new */
			0x3d 0x4a /* 0x90~0x91 */

			/* battery,soc_arr_val */
			10557 10031 9505 8979 8454 7927 7402 6876 6349 5824
			5298 4771 4246 3720 3194 2668 2142 1616 1090 565
			39 (-55)

			/* battery,ocv_arr_val */
			44486 43943 43431 42857 42242 41634 41056 40521 40038 39486
			38922 38602 38346 38140 37970 37786 37532 37259 36945 36817
			33341 31126

			/* battery,rRS_CC0 */
			0x13 /* [0x5C] */

			/***** battery data for 4.37 *****/
			/* battery,battery_table3 */
			151 11 40 11 191 10 73 10 203 9
			79 9 216 8 107 8 8 8 151 7
			35 7 226 6 173 6 131 6 96 6
			59 6 7 6 207 5 142 5 116 5
			172 2 231 0 227 8 113 8 0 8
			143 7 29 7 172 6 59 6 201 5
			88 5 231 4 117 4 4 4 147 3
			33 3 176 2 63 2 206 1 92 1
			235 0 122 0 8 0 244 15

			/* battery,battery_table4 */
			13 13 13 13 13 26 25 25 25 26
			26 26 26 26 27 27 27 27 27 27
			28 154

			/* battery,batcap */
			0x90 0x46 0x59 0xc /* [0x0E] [0x0F] [0x10] [0x11] */

			/* battery,designcap */
			0x90 0x46 /* [0x86~0x87] */

			/* battery,batcap_ocv_new */
			0x91 0x46 /* 0x90~0x91 */

			/* battery,soc_arr_val */
			11106 10553 9999 9446 8893 8340 7787 7233 6679 6127
			5573 5019 4466 3913 3360 2807 2254 1700 1147 594
			41 (-58)

			/* battery,ocv_arr_val */
			44486 43943 43431 42857 42242 41634 41056 40521 40038 39486
			38922 38602 38346 38140 37970 37786 37532 37259 36945 36817
			33341 31126

			/* battery,rRS_CC0 */
			0x13 /* [0x5C] */

			>;
	/* 01: ATL_safe */
		battery1,battery_data = <
			/***** battery data for 4.48 *****/
			/* battery,battery_table3 */
			152 11 33 11 185 10 67 10 197 9
			73 9 210 8 101 8 3 8 157 7
			33 7 222 6 170 6 129 6 95 6
			59 6 10 6 218 5 146 5 125 5
			168 3 24 2 0 8 154 7 52 7
			206 6 105 6 3 6 157 5 55 5
			209 4 107 4 5 4 160 3 58 3
			212 2 110 2 8 2 162 1 60 1
			214 0 112 0 11 0 239 15

			/* battery,battery_table4 */
			14 14 14 13 25 25 25 25 25 25
			25 25 25 25 25 25 25 26 26 27
			28 90

			/* battery,batcap */
			0x3f 0x51 0x37 0xe /* [0x0E] [0x0F] [0x10] [0x11] */

			/* battery,designcap */
			0x3f 0x51 /* [0x86~0x87] */

			/* battery,batcap_ocv_new */
			0x3f 0x51 /* 0x90~0x91 */

			/* battery,soc_arr_val */
			10000 9503 9005 8508 8011 7513 7016 6518 6021 5524
			5026 4529 4031 3534 3036 2539 2042 1544 1047 549
			52 (-85)

			/* battery,ocv_arr_val */
			44493 43913 43402 42827 42212 41605 41027 40494 40015 39519
			38909 38586 38332 38128 37966 37789 37550 37313 36961 36859
			34572 32617

			/* battery,rRS_CC0 */
			0x12 /* [0x5C] */

			/***** battery data for 4.46 *****/
			/* battery,battery_table3 */
			152 11 33 11 185 10 67 10 197 9
			73 9 210 8 101 8 3 8 157 7
			33 7 222 6 170 6 129 6 95 6
			59 6 10 6 218 5 146 5 125 5
			168 3 24 2 28 8 181 7 77 7
			230 6 127 6 24 6 176 5 73 5
			226 4 122 4 19 4 172 3 69 3
			221 2 118 2 15 2 168 1 64 1
			217 0 114 0 11 0 238 15

			/* battery,battery_table4 */
			14 14 14 13 25 25 25 25 25 25
			25 25 25 25 25 25 25 26 26 27
			28 90

			/* battery,batcap */
			0x26 0x50 0x06 0xe /* [0x0E] [0x0F] [0x10] [0x11] */

			/* battery,designcap */
			0x26 0x50 /* [0x86~0x87] */

			/* battery,batcap_ocv_new */
			0x27 0x50 /* 0x90~0x91 */

			/* battery,soc_arr_val */
			10136 9632 9128 8623 8119 7615 7111 6607 6103 5598
			5094 4590 4086 3581 3077 2573 2069 1565 1061 556
			52 (-86)

			/* battery,ocv_arr_val */
			44493 43913 43402 42827 42212 41605 41027 40494 40015 39519
			38909 38586 38332 38128 37966 37789 37550 37313 36961 36859
			34572 32617

			/* battery,rRS_CC0 */
			0x12 /* [0x5C] */

			/***** battery data for 4.44 *****/
			/* battery,battery_table3 */
			152 11 33 11 185 10 67 10 197 9
			73 9 210 8 101 8 3 8 157 7
			33 7 222 6 170 6 129 6 95 6
			59 6 10 6 218 5 146 5 125 5
			168 3 24 2 62 8 213 7 108 7
			3 7 154 6 49 6 200 5 95 5
			246 4 141 4 36 4 187 3 83 3
			234 2 129 2 24 2 175 1 70 1
			221 0 116 0 11 0 238 15

			/* battery,battery_table4 */
			14 14 14 13 25 25 25 25 25 25
			25 25 25 25 25 25 25 26 26 27
			28 90

			/* battery,batcap */
			0xdb 0x4e 0xcc 0xd /* [0x0E] [0x0F] [0x10] [0x11] */

			/* battery,designcap */
			0xdb 0x4e /* [0x86~0x87] */

			/* battery,batcap_ocv_new */
			0xdb 0x4e /* 0x90~0x91 */

			/* battery,soc_arr_val */
			10303 9790 9278 8765 8253 7740 7228 6716 6203 5690
			5178 4665 4153 3641 3128 2615 2103 1590 1078 565
			53 (-88)

			/* battery,ocv_arr_val */
			44493 43913 43402 42827 42212 41605 41027 40494 40015 39519
			38909 38586 38332 38128 37966 37789 37550 37313 36961 36859
			34572 32617

			/* battery,rRS_CC0 */
			0x12 /* [0x5C] */

			/***** battery data for 4.42 *****/
			/* battery,battery_table3 */
			152 11 33 11 185 10 67 10 197 9
			73 9 210 8 101 8 3 8 157 7
			33 7 222 6 170 6 129 6 95 6
			59 6 10 6 218 5 146 5 125 5
			168 3 24 2 104 8 253 7 146 7
			39 7 188 6 81 6 230 5 123 5
			16 5 165 4 58 4 206 3 99 3
			248 2 141 2 34 2 183 1 76 1
			225 0 118 0 11 0 238 15

			/* battery,battery_table4 */
			14 14 14 13 25 25 25 25 25 25
			25 25 25 25 25 25 25 26 26 27
			28 90

			/* battery,batcap */
			0x52 0x4d 0x87 0xd  /* [0x0E] [0x0F] [0x10] [0x11] */

			/* battery,designcap */
			0x52 0x4d /* [0x86~0x87] */

			/* battery,batcap_ocv_new */
			0x52 0x4d /* 0x90~0x91 */

			/* battery,soc_arr_val */
			10508 9985 9462 8940 8417 7894 7372 6849 6326 5804
			5281 4758 4235 3713 3190 2667 2145 1622 1100 577
			54 (-89)

			/* battery,ocv_arr_val */
			44493 43913 43402 42827 42212 41605 41027 40494 40015 39519
			38909 38586 38332 38128 37966 37789 37550 37313 36961 36859
			34572 32617

			/* battery,rRS_CC0 */
			0x12 /* [0x5C] */

			/***** battery data for 4.37 *****/
			/* battery,battery_table3 */
			152 11 33 11 185 10 67 10 197 9
			73 9 210 8 101 8 3 8 157 7
			33 7 222 6 170 6 129 6 95 6
			59 6 10 6 218 5 146 5 125 5
			168 3 24 2 212 8 99 8 243 7
			130 7 18 7 162 6 49 6 193 5
			80 5 224 4 111 4 255 3 143 3
			30 3 174 2 62 2 205 1 93 1
			236 0 124 0 12 0 237 15

			/* battery,battery_table4 */
			14 14 14 13 25 25 25 25 25 25
			25 25 25 25 25 25 25 26 26 27
			28 90

			/* battery,batcap */
			0xa5 0x49 0xe2 0xc /* [0x0E] [0x0F] [0x10] [0x11] */

			/* battery,designcap */
			0xa5 0x49 /* [0x86~0x87] */

			/* battery,batcap_ocv_new */
			0xa5 0x49 /* 0x90~0x91 */

			/* battery,soc_arr_val */
			11033 10484 9935 9386 8837 8289 7740 7191 6642 6093
			5544 4996 4447 3898 3349 2801 2252 1703 1154 605
			57 (-94)

			/* battery,ocv_arr_val */
			44493 43913 43402 42827 42212 41605 41027 40494 40015 39519
			38909 38586 38332 38128 37966 37789 37550 37313 36961 36859
			34572 32617

			/* battery,rRS_CC0 */
			0x12 /* [0x5C] */

			>;
	/* 00: ATL_safe */
		battery0,battery_data = <
			/***** battery data for 4.48 *****/
			/* battery,battery_table3 */
			151 11 40 11 191 10 73 10 203 9
			79 9 216 8 107 8 8 8 151 7
			35 7 226 6 173 6 131 6 96 6
			59 6 7 6 207 5 142 5 116 5
			172 2 231 0 0 8 154 7 52 7
			206 6 104 6 2 6 156 5 54 5
			208 4 106 4 4 4 158 3 56 3
			210 2 108 2 6 2 160 1 57 1
			212 0 110 0 7 0 245 15

			/* battery,battery_table4 */
			13 13 13 13 26 26 25 25 25 26
			26 26 26 26 27 27 27 27 27 27
			28 154

			/* battery,batcap */
			0xf8 0x51 0xb8 0xb /* [0x0E] [0x0F] [0x10] [0x11] */

			/* battery,designcap */
			0xf8 0x51 /* [0x86~0x87] */

			/* battery,batcap_ocv_new */
			0xf9 0x51 /* 0x90~0x91 */

			/* battery,soc_arr_val */
			10000 9502 9003 8505 8007 7509 7011 6513 6014 5516
			5018 4520  4022 3523 3025 2527 2029 1531 1033 535
			37 (-53)

			/* battery,ocv_arr_val */
			44486 43943 43431 42857 42242 41634 41056 40521 40038 39486
			38922 38602 38346 38140 37970 37786 37532 37259 36945 36817
			33341 31126

			/* battery,rRS_CC0 */
			0x13 /* [0x5C] */

			/***** battery data for 4.46 *****/
			/* battery,battery_table3 */
			151 11 40 11 191 10 73 10 203 9
			79 9 216 8 107 8 8 8 151 7
			35 7 226 6 173 6 131 6 96 6
			59 6 7 6 207 5 142 5 116 5
			172 2 231 0 31 8 183 7 80 7
			232 6 129 6 25 6 178 5 74 5
			226 4 123 4 19 4 172 3 68 3
			221 2 117 2 13 2 166 1 62 1
			215 0 111 0 8 0 245 15

			/* battery,battery_table4 */
			13 13 13 13 26 26 25 25 25 26
			26 26 26 26 27 27 27 27 27 27
			28 154

			/* battery,batcap */
			0x30 0x4d 0x82 0xd /* [0x0E] [0x0F] [0x10] [0x11] */

			/* battery,designcap */
			0x30 0x4d /* [0x86~0x87] */

			/* battery,batcap_ocv_new */
			0x31 0x4d /* 0x90~0x91 */

			/* battery,soc_arr_val */
			10152 9646 9140 8634 8129 7623 7117 6611 6105 5600
			5094 4588 4083 3577 3071 2566 2060 1554 1048 543
			37 (-53)

			/* battery,ocv_arr_val */
			44486 43943 43431 42857 42242 41634 41056 40521 40038 39486
			38922 38602 38346 38140 37970 37786 37532 37259 36945 36817
			33341 31126

			/* battery,rRS_CC0 */
			0x13 /* [0x5C] */

			/***** battery data for 4.44 *****/
			/* battery,battery_table3 */
			151 11 40 11 191 10 73 10 203 9
			79 9 216 8 107 8 8 8 151 7
			35 7 226 6 173 6 131 6 96 6
			59 6 7 6 207 5 142 5 116 5
			172 2 231 0 72 8 222 7 116 7
			11 7 161 6 56 6 206 5 101 5
			251 4 145 4 40 4 190 3 85 3
			235 2 129 2 24 2 174 1 68 1
			219 0 113 0 8 0 245 15

			/* battery,battery_table4 */
			13 13 13 13 26 26 25 25 25 26
			26 26 26 26 27 27 27 27 27 27
			28 154

			/* battery,batcap */
			0xb4 0x4b 0x3f 0xd /* [0x0E] [0x0F] [0x10] [0x11] */

			/* battery,designcap */
			0xb4 0x4b /* [0x86~0x87] */

			/* battery,batcap_ocv_new */
			0xb5 0x4b /* 0x90~0x91 */

			/* battery,soc_arr_val */
			10350 9835 9319 8803 8288 7772 7257 6741 6225 5710
			5194 4678 4163 3647 3131 2616 2100 1584 1069 554
			38 (-54)

			/* battery,ocv_arr_val */
			44486 43943 43431 42857 42242 41634 41056 40521 40038 39486
			38922 38602 38346 38140 37970 37786 37532 37259 36945 36817
			33341 31126

			/* battery,rRS_CC0 */
			0x13 /* [0x5C] */

			/***** battery data for 4.42 *****/
			/* battery,battery_table3 */
			151 11 40 11 191 10 73 10 203 9
			79 9 216 8 107 8 8 8 151 7
			35 7 226 6 173 6 131 6 96 6
			59 6 7 6 207 5 142 5 116 5
			172 2 231 0 114 8 6 8 155 7
			47 7 195 6 88 6 236 5 128 5
			20 5 169 4 61 4 209 3 102 3
			250 2 142 2 34 2 183 1 75 1
			223 0 116 0 8 0 245 15

			/* battery,battery_table4 */
			13 13 13 13 26 26 25 25 25 26
			26 26 26 26 27 27 27 27 27 27
			28 154

			/* battery,batcap */
			0x3c 0x4a 0xfd 0xc  /* [0x0E] [0x0F] [0x10] [0x11] */

			/* battery,designcap */
			0x3c 0x4a /* [0x86~0x87] */

			/* battery,batcap_ocv_new */
			0x3d 0x4a /* 0x90~0x91 */

			/* battery,soc_arr_val */
			10557 10031 9505 8979 8454 7927 7402 6876 6349 5824
			5298 4771 4246 3720 3194 2668 2142 1616 1090 565
			39 (-55)

			/* battery,ocv_arr_val */
			44486 43943 43431 42857 42242 41634 41056 40521 40038 39486
			38922 38602 38346 38140 37970 37786 37532 37259 36945 36817
			33341 31126

			/* battery,rRS_CC0 */
			0x13 /* [0x5C] */

			/***** battery data for 4.37 *****/
			/* battery,battery_table3 */
			151 11 40 11 191 10 73 10 203 9
			79 9 216 8 107 8 8 8 151 7
			35 7 226 6 173 6 131 6 96 6
			59 6 7 6 207 5 142 5 116 5
			172 2 231 0 227 8 113 8 0 8
			143 7 29 7 172 6 59 6 201 5
			88 5 231 4 117 4 4 4 147 3
			33 3 176 2 63 2 206 1 92 1
			235 0 122 0 8 0 244 15

			/* battery,battery_table4 */
			13 13 13 13 13 26 25 25 25 26
			26 26 26 26 27 27 27 27 27 27
			28 154

			/* battery,batcap */
			0x90 0x46 0x59 0xc /* [0x0E] [0x0F] [0x10] [0x11] */

			/* battery,designcap */
			0x90 0x46 /* [0x86~0x87] */

			/* battery,batcap_ocv_new */
			0x91 0x46 /* 0x90~0x91 */

			/* battery,soc_arr_val */
			11106 10553 9999 9446 8893 8340 7787 7233 6679 6127
			5573 5019 4466 3913 3360 2807 2254 1700 1147 594
			41 (-58)

			/* battery,ocv_arr_val */
			44486 43943 43431 42857 42242 41634 41056 40521 40038 39486
			38922 38602 38346 38140 37970 37786 37532 37259 36945 36817
			33341 31126

			/* battery,rRS_CC0 */
			0x13 /* [0x5C] */

			>;
	};
};
